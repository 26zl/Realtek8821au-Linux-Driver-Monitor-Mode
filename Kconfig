## Kconfig
```kconfig
config RTL8821AU
	tristate "Realtek 8821A USB WiFi"
	depends on USB
	help
	  Realtek RTL8821AU/RTL8811AU USB WiFi adapter driver.
	  Supports managed, monitor, and AP modes on 2.4 GHz and 5 GHz bands.
```
